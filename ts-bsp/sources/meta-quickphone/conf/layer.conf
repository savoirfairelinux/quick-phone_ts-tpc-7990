## ts-bsp/sources/meta-quickphone/conf/layer.conf
```bitbake
# We have a conf and classes directory, add to BBPATH
BBPATH .= ":${LAYERDIR}"

# We have recipes-* directories, add to BBFILES
BBFILES += "${LAYERDIR}/recipes-*/*/*.bb \
	${LAYERDIR}/recipes-*/*/*.bbappend"

BBFILE_COLLECTIONS += "quickphone"
BBFILE_PATTERN_quickphone = "^${LAYERDIR}/"
BBFILE_PRIORITY_quickphone = "6"

LAYERDEPENDS_quickphone = "ts"
```
